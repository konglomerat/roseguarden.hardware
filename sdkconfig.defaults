## sdkconfig.defaults
```kconfig
CONFIG_ESP_MAIN_TASK_STACK_SIZE=2048

CONFIG_ESPTOOLPY_FLASHSIZE_4MB=y
CONFIG_ESPTOOLPY_FLASHSIZE="4MB"

CONFIG_ESPTOOLPY_BAUD_OTHER_VAL=460800
CONFIG_ESPTOOLPY_MONITOR_BAUD_OTHER_VAL=115200

CONFIG_MBEDTLS_CERTIFICATE_BUNDLE=y
CONFIG_MBEDTLS_CERTIFICATE_BUNDLE_DEFAULT_NONE=y
CONFIG_MBEDTLS_CUSTOM_CERTIFICATE_BUNDLE=y
CONFIG_MBEDTLS_CUSTOM_CERTIFICATE_BUNDLE_PATH="src/cert.pem"

CONFIG_ESP_TIMER_TASK_STACK_SIZE=3584
CONFIG_TIMER_TASK_STACK_SIZE=3584

CONFIG_COMPILER_OPTIMIZATION_SIZE=y
CONFIG_COMPILER_OPTIMIZATION_LEVEL_RELEASE=y
CONFIG_SPI_MASTER_IN_IRAM=y

CONFIG_TASK_WDT_PANIC=y

#IF THIS BUILD SHOULD BE USED FOR PRODUCTION REBOOT FROM PANIC HANDLER
#HALT THE CONTROLLE AND START A GDB STUB
#ONLY ONE OF THE TWO OPTIONS CAN BE ACTIVE
#CONFIG_ESP32S2_PANIC_GDBSTUB=y
CONFIG_ESP32S2_PANIC_PRINT_REBOOT=y

#
# Roseguarden
#
CONFIG_ROSEGUARDEN_SET_DEVICE_AS_REGISTRATION_TERMINAL=n
CONFIG_ROSEGUARDEN_WIFI_SSID=""
CONFIG_ROSEGUARDEN_WIFI_PASSWORD=""
CONFIG_ROSEGUARDEN_NODE_NAME=""
CONFIG_ROSEGUARDEN_NODE_FINGERPRINT=""
CONFIG_ROSEGUARDEN_NODE_AUTHENTIFICATION=""
CONFIG_ROSEGUARDEN_SERVER_URL=""
# end of Roseguarden
```

## src/Kconfig.projbuild
```kconfig
menu "Roseguarden"

    config ROSEGUARDEN_WIFI_SSID
        string "WIFI SSID"
        default ""
        help
            SSID to connect to

    config ROSEGUARDEN_WIFI_PASSWORD
        string "WIFI Password"
        default ""
        help
            WIFI password (leave empty is network is not encrypted)
            
    config ROSEGUARDEN_NODE_NAME
        string "Node Name"
        default ""
        help
            Human-readable name of the node
            
    config ROSEGUARDEN_NODE_FINGERPRINT
        string "Node Fingerprint"
        default "00:11:22:33:44:55:66:77:88:99:AA:BB:CC:DD:EE:FF:00:11:22:33"
        help
            Fingerprint of the node in hex notation
            
    config ROSEGUARDEN_NODE_AUTHENTIFICATION
        string "Node Authentification"
        default "Kol-Bi-Hop-Ban-Gan-To-Sep+129"
        help
            Authentication string of the node
            
    config ROSEGUARDEN_SERVER_URL
        string "Endpoint url to communicate with"
        default "https://roseguarden.fabba.space/api/v1/nodes"
        help
            Full url with leading http[s]://
           
endmenu
```
